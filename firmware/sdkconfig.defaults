## firmware/sdkconfig.defaults
```kconfig
# ESP32-S3-RLCD-4.2 桌面摆件固件默认配置
CONFIG_IDF_TARGET="esp32s3"
CONFIG_ESPTOOLPY_FLASHMODE_QIO=y
CONFIG_ESPTOOLPY_FLASHSIZE_16MB=y
CONFIG_PARTITION_TABLE_CUSTOM=y
CONFIG_PARTITION_TABLE_CUSTOM_FILENAME="partitions.csv"

# BLE（RaceBox 采集用，NimBLE 内存占用小）
CONFIG_BT_ENABLED=y
CONFIG_BT_NIMBLE_ENABLED=y
CONFIG_BT_NIMBLE_MAX_CONNECTIONS=2
CONFIG_BT_NIMBLE_ROLE_CENTRAL=y
CONFIG_BT_NIMBLE_ROLE_OBSERVER=y
CONFIG_BT_NIMBLE_ROLE_PERIPHERAL=n
CONFIG_BT_NIMBLE_MSYS_1_BLOCK_COUNT=24
CONFIG_BT_NIMBLE_TRANSPORT_ACL_FROM_LL_COUNT=48
CONFIG_BT_ABORT_WHEN_ALLOCATION_FAILS=y

# HTTP 服务（配置后台）
CONFIG_HTTPD_MAX_REQ_HDR_LEN=512
CONFIG_HTTPD_MAX_URI_LEN=1024

# PSRAM（8MB Octal）
CONFIG_SPIRAM=y
CONFIG_SPIRAM_MODE_OCT=y
CONFIG_SPIRAM_SPEED_80M=y

# 文件系统（TF 卡 FATFS / SPIFFS 静态资源）
CONFIG_FATFS_LFN_HEAP=y
CONFIG_SPIFFS_USE_MAGIC=y

# FreeRTOS
CONFIG_FREERTOS_HZ=1000
CONFIG_FREERTOS_CHECK_STACKOVERFLOW_CANARY=y

# LVGL 8.4
CONFIG_LV_MEM_SIZE_KILOBYTES=128
CONFIG_LV_DISP_DEF_REFR_PERIOD=1
CONFIG_LV_INDEV_DEF_READ_PERIOD=50
CONFIG_LV_TXT_BREAK_CHARS=" ,.;:-_)}"
CONFIG_LV_USE_SNAPSHOT=n
CONFIG_LV_FONT_MONTSERRAT_14=y
CONFIG_LV_FONT_MONTSERRAT_20=y
CONFIG_LV_FONT_MONTSERRAT_48=y

# 日志
CONFIG_LOG_DEFAULT_LEVEL_INFO=y

# TLS 握手对象放入板载 PSRAM，避免内部堆不足导致 -0x7F00。
# 网络任务栈仍保留在内部 RAM，确保 ROM/网络调用路径稳定。
CONFIG_MBEDTLS_EXTERNAL_MEM_ALLOC=y
```
